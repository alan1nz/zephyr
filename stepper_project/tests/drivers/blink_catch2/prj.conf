## CMakeLists.txt
```
# SPDX-License-Identifier: Apache-2.0

cmake_minimum_required(VERSION 3.20.0)
find_package(Zephyr REQUIRED HINTS $ENV{ZEPHYR_BASE})

project(blink_catch2 LANGUAGES C CXX)

# Skip Catch2's own self-tests/docs/examples when built as a subdirectory.
set(CATCH_BUILD_TESTING OFF CACHE BOOL "" FORCE)
set(CATCH_INSTALL_DOCS OFF CACHE BOOL "" FORCE)
set(CATCH_INSTALL_EXTRAS OFF CACHE BOOL "" FORCE)

add_subdirectory(${WEST_TOPDIR}/modules/thirdparty/catch2 ${CMAKE_BINARY_DIR}/catch2)

# Catch2 doesn't go through zephyr_library(), so it won't automatically pick
# up Zephyr's toolchain/target flags (cross-compiler, arch flags, defines).
target_link_libraries(Catch2 PRIVATE zephyr_interface)

target_sources(app PRIVATE src/main.cpp)

target_compile_options(app PRIVATE
    -Wno-error=unused-const-variable
    -Wno-error=unused-variable
)

# Link against Catch2, not Catch2WithMain: we supply our own main() so it can
# explicitly exit the process once the session finishes (see main.cpp).
target_link_libraries(app PRIVATE Catch2::Catch2)
```

## prj.conf
```kconfig
# SPDX-License-Identifier: Apache-2.0
#
# This is a plain Zephyr application (not a ztest test), so it supplies its
# own main() that runs the Catch2 session instead of ztest's runner.

CONFIG_CPP=y
CONFIG_STD_CPP17=y
CONFIG_CPP_EXCEPTIONS=y
CONFIG_CPP_RTTI=y
CONFIG_REQUIRES_FULL_LIBCPP=y
CONFIG_NEWLIB_LIBC=y
CONFIG_NEWLIB_LIBC_FLOAT_PRINTF=y

CONFIG_CONSOLE=y
CONFIG_PRINTK=y

CONFIG_GPIO=y
CONFIG_GPIO_EMUL=y

CONFIG_BLINK=y
CONFIG_BLINK_GPIO_LED=y

CONFIG_MAIN_STACK_SIZE=8192
```

## app.overlay
```dts
/*
 * SPDX-License-Identifier: Apache-2.0
 *
 * Constructs a real blink-gpio-led instance on native_sim's emulated GPIO
 * (gpio0 is "zephyr,gpio-emul", already enabled in native_sim.dts).
 */

#include <zephyr/dt-bindings/gpio/gpio.h>

/ {
	my_led1: my-led {
		compatible = "blink-gpio-led";
		led-gpios = <&gpio0 0 GPIO_ACTIVE_HIGH>;
		blink-period-ms = <100>;
		status = "okay";
	};
};
```

## src/main.cpp
```c
/*
 * SPDX-License-Identifier: Apache-2.0
 *
 * Unit tests for the "blink" gpio_led driver using Catch2 instead of ztest.
 * The device instance below is constructed entirely from devicetree (see
 * app.overlay), exactly as it would be on real hardware.
 */

#include <catch2/catch_session.hpp>
#include <catch2/catch_test_macros.hpp>

#include <cstdlib>

#include <zephyr/device.h>
#include <zephyr/devicetree.h>
#include <zephyr/drivers/gpio.h>
#include <zephyr/drivers/gpio/gpio_emul.h>
#include <zephyr/kernel.h>

#include <app/drivers/blink.h>

namespace {

const struct device *led_dev = DEVICE_DT_GET(DT_NODELABEL(my_led1));
const struct gpio_dt_spec led_gpio = GPIO_DT_SPEC_GET(DT_NODELABEL(my_led1), led_gpios);

} /* namespace */

SCENARIO("blink device readiness", "[blink]")
{
	GIVEN("a blink device constructed from devicetree")
	{
		THEN("it is ready")
		{
			REQUIRE(device_is_ready(led_dev));
		}
	}
}

SCENARIO("turning the blink LED off", "[blink]")
{
	GIVEN("a ready blink device")
	{
		WHEN("blink_off is called")
		{
			REQUIRE(blink_off(led_dev) == 0);
			k_msleep(50);

			THEN("the LED gpio is driven inactive")
			{
				REQUIRE(gpio_emul_output_get_dt(&led_gpio) == 0);
			}
		}
	}
}

SCENARIO("blinking the LED at a configured period", "[blink]")
{
	GIVEN("a ready blink device")
	{
		WHEN("blink_set_period_ms is called with a non-zero period")
		{
			REQUIRE(blink_set_period_ms(led_dev, 10) == 0);

			THEN("the LED gpio toggles over time")
			{
				int last = gpio_emul_output_get_dt(&led_gpio);
				bool toggled = false;

				/* Poll for a change in output level within a generous timeout. */
				for (int i = 0; i < 50 && !toggled; i++) {
					k_msleep(5);
					toggled = gpio_emul_output_get_dt(&led_gpio) != last;
				}

				REQUIRE(toggled);
			}

			AND_WHEN("blink_off is called afterwards")
			{
				THEN("it stops the blinking")
				{
					REQUIRE(blink_off(led_dev) == 0);
				}
			}
		}
	}
}

int main(void)
{
	int result = Catch::Session().run();

	/* native_sim is a real host process; returning from main() here does
	 * not terminate it (the idle thread just keeps the process alive), so
	 * exit explicitly instead.
	 */
	std::exit(result);
}
```
