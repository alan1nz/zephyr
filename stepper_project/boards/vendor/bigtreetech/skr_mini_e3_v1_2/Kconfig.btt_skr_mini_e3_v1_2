## stepper_project/boards/vendor/bigtreetech/skr_mini_e3_v1_2/Kconfig.btt_skr_mini_e3_v1_2
```kconfig
# SPDX-License-Identifier: Apache-2.0

config BOARD_BTT_SKR_MINI_E3_V1_2
	select SOC_STM32F103XE
```

## stepper_project/boards/vendor/bigtreetech/skr_mini_e3_v1_2/board.yml
```yaml
# SPDX-License-Identifier: Apache-2.0

board:
  name: btt_skr_mini_e3_v1_2
  full_name: BIGTREETECH SKR Mini E3 V1.2
  vendor: bigtreetech
  socs:
    - name: stm32f103xe
```

## stepper_project/drivers/my_driver/Kconfig
```kconfig
# SPDX-License-Identifier: Apache-2.0

menuconfig MY_DRIVER
	bool "MyDriver device drivers"
	help
	  This option enables the my_driver custom driver class.

if MY_DRIVER

config MY_DRIVER_INIT_PRIORITY
	int "MyDriver device drivers init priority"
	default KERNEL_INIT_PRIORITY_DEVICE
	help
	  MyDriver device drivers init priority.

module = MY_DRIVER
module-str = my_driver
source "subsys/logging/Kconfig.template.log_config"

rsource "Kconfig.my_driver"

endif # MY_DRIVER
```

## stepper_project/drivers/my_driver/Kconfig.gpio
```kconfig
# SPDX-License-Identifier: Apache-2.0

config MY_DRIVER_GPIO
	bool "Gpio my_driver driver"
	default y
	depends on DT_HAS_MY_DRIVER_GPIO_ENABLED
	help
	  Enable this option to use the gpio my_driver driver.
```

## stepper_project/drivers/my_driver/Kconfig.my_driver
```kconfig
# SPDX-License-Identifier: Apache-2.0

config MY_DRIVER_MY_DRIVER
	bool "MyDriver my_driver driver"
	default y
	depends on DT_HAS_MY_DRIVER_MY_DRIVER_ENABLED
	help
	  Enable this option to use the my_driver my_driver driver.
```

## stepper_project/dts/bindings/my_driver/my-driver-gpio.yaml
```yaml
# SPDX-License-Identifier: Apache-2.0

description: |
  A binding for the gpio implementation of the my_driver driver class.

  Example definition in devicetree:

    my-driver-gpio {
        compatible = "my-driver-gpio";
    };

compatible: "my-driver-gpio"

include: base.yaml

properties:
  # TODO: add implementation specific properties here.
```

## stepper_project/dts/bindings/my_driver/my-driver-my-driver.yaml
```yaml
# SPDX-License-Identifier: Apache-2.0

description: |
  A binding for the my_driver implementation of the my_driver driver class.

  Example definition in devicetree:

    my-driver-my-driver {
        compatible = "my-driver-my-driver";
    };

compatible: "my-driver-my-driver"

include: base.yaml

properties:
  # TODO: add implementation specific properties here.
```

## stepper_project/dts/bindings/myled/my-led.yml
```yaml
description: |
  A generic binding for controlling a LED via GPIO
  
  Example definition in device tree:
  
  my-led{
    compatible = "my-led"

  }


compatible: "my-led"
include: base.yaml

properties:
  gpios:
    type: phandle-array
    required: true
    description: gpio controlled led

  blink-period-ms:
    type: int
    description: Blinking period in milliseconds
```

## stepper_project/lib/units/Kconfig
```kconfig
# SPDX-License-Identifier: Apache-2.0

config UNITS
	bool "Support for the units literals library"
	select CPP
	help
	  This option enables the 'units' library, providing strongly-typed
	  physical quantities (Volts, Celsius, Millimeters, ...) via C++
	  user-defined literals, e.g. `48.0_v`, `23_celsius`.
```

## stepper_project/tests/drivers/blink_catch2/testcase.yaml
```yaml
tests:
  drivers.blink.unit_testing:
    tags: unit_test drivers
    platform_allow: native_sim/native/64
```

## stepper_project/tests/drivers/blink_unit_testing/testcase.yaml
```yaml
tests:
  drivers.blink.unit_testing:
    tags: unit_test drivers
    platform_allow: unit_testing
```

## stepper_project/west.yml
```yaml
# Copyright (c) 2021 Nordic Semiconductor ASA
# SPDX-License-Identifier: Apache-2.0

manifest:
  self:
    west-commands: scripts/west-commands.yml

  remotes:
    - name: zephyrproject-rtos
      url-base: https://github.com/zephyrproject-rtos

    - name: googletest
      url-base: https://github.com/google

  projects:
    - name: zephyr
      remote: zephyrproject-rtos
      revision: main
      import:
        # By using name-allowlist we can clone only the modules that are
        # strictly needed by the application.
        name-allowlist:
          - cmsis_6    # required by the ARM port for Cortex-M
          - hal_nordic # required by the custom_plank board (Nordic based)
          - hal_stm32  # required by the nucleo_f302r8 board (STM32 based)
          - hal_espressif

    - name: googletest
      remote: googletest
      revision: main
      path: modules/thirdparty/gtest
```
